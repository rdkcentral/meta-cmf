## conf/distro/include/rdkcmf.inc
```bitbake
MAINTAINER = "RDK CMF Team <support@rdkcentral.com>"

CMF_GIT_MAIN_BRANCH ?= "main"

PREFERRED_PROVIDER_curl ?= "curl"

# Revert meta-rdk/+/73763 RDKTV-17032: Build failure due to compiler out of memory
# It is causing race condition issues in build
PARALLEL_MAKE_remove = " -l ${@int(os.sysconf(os.sysconf_names['SC_NPROCESSORS_ONLN'])) * 150/100}"

# Add mixed mode support in addition to the list in
# meta-rdk/conf/distro/include/license_flags_whitelist.inc
require ${@bb.utils.contains_any('DISTRO_FEATURES','dunfell','license_flags_whitelist.inc','license_flags_accepted.inc',d)}
```

## conf/layer.conf
```bitbake
BBPATH .= ":${LAYERDIR}"

BBFILES += "\
            ${LAYERDIR}/recipes-*/*/*.bb \
            ${LAYERDIR}/recipes-*/*/*/*.bb \
            ${LAYERDIR}/recipes-*/*/*.bbappend \
            ${LAYERDIR}/recipes-*/*/*/*.bbappend \
           "

BBFILE_COLLECTIONS += "cmf"
BBFILE_PATTERN_cmf := "^${LAYERDIR}/"
#BBFILE_PRIORITY_cmf = "25"

LAYERSERIES_COMPAT_cmf = "dunfell kirkstone"

# Additional license directories.
LICENSE_PATH += "${LAYERDIR}/licenses"

LAYERDEPENDS_cmf = "rdk"

RDK_ROOT_PATH = "${LAYERDIR}/.."

require conf/distro/include/rdkcmf.inc

PREFERRED_PROVIDER_virtual/samplemedia ?= "linaro-samplemedia"
PREFERRED_VERSION_lighttpd = "1.4.39"

#Temporary bbmasks for components that have not been opensourced yet
BBMASK .= "|meta-rdk-broadband/recipes-ccsp/ccsp/batterymgr.bb"
BBMASK .= "|meta-rdk-broadband/recipes-ccsp/ccsp/rfc-agent.bb"
BBMASK .= "|meta-rdk-broadband/recipes-ccsp/ccsp/gatewaymanager.bb"
BBMASK .= "|meta-rdk-broadband/recipes-ccsp/rdk-wifi-emulator-hal/"
BBMASK .= "|meta-rdk-broadband/recipes-ccsp/wifi-emulator/"

# Masking the duplicate googletest recipe in meta-rdk-ext. Use the one in
# meta-openembedded
BBMASK .= "|meta-rdk-ext/recipes-test/googletest/"

# Masking recipes for deprecated components that can be overridden in dependent layers
BBMASK += "meta-rdk-ext/recipes-extended/libqjson/"
BBMASK += "meta-rdk-ext/recipes-support/fcgi/"

DISTRO_FEATURES_append_arm = " ld-is-gold"
DISTRO_FEATURES_append_x86 = " ld-is-gold"
DISTRO_FEATURES_append = " virtualization"

DISTRO_FEATURES_append_kirkstone = " kirkstone"
PREFERRED_VERSION_plymouth_kirkstone = "0.9.5"

# Masking the below recipes because in kirkstone build recipes pulling older version due to layer priority
BBMASK .= "${@bb.utils.contains('DISTRO_FEATURES', 'kirkstone', '|.meta-rdk-ext/recipes-devtools/jsonrpc/jsonrpc_0.7.0.bb', '', d)}"
```
